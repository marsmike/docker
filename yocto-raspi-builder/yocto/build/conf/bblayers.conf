## yocto-raspi-builder/yocto/build/conf/bblayers.conf
```bitbake
# POKY_BBLAYERS_CONF_VERSION is increased each time build/conf/bblayers.conf
# changes incompatibly
POKY_BBLAYERS_CONF_VERSION = "2"

BBPATH = "${TOPDIR}"
BBFILES ?= ""

BBLAYERS ?= " \
    /opt/yocto/poky-thud/meta \
    /opt/yocto/poky-thud/meta-poky \
    /opt/yocto/poky-thud/meta-openembedded/meta-oe \
    /opt/yocto/poky-thud/meta-openembedded/meta-multimedia \
    /opt/yocto/poky-thud/meta-openembedded/meta-networking \
    /opt/yocto/poky-thud/meta-openembedded/meta-perl \
    /opt/yocto/poky-thud/meta-openembedded/meta-python \
    /opt/yocto/poky-thud/meta-qt5 \
    /opt/yocto/poky-thud/meta-raspberrypi \
    /home/build/meta-rpi \
"
```
